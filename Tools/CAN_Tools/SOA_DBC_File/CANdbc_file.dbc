VERSION ""

NS_ :

BS_:

BU_: SDV_Tester SDV_M_CORE0
VAL_TABLE_ Exit_Request_stauts 1 "Quit request" 0 "No Quit request" ;
VAL_TABLE_ KST_KL_15 1 "KL15 ON" 0 "KL15 OFF" ;

BO_ 512 Standard_100_Rx: 1 SDV_Tester
 SG_ Test_ID_0x200 : 7|8@0+ (1,0) [0|1000] ""  SDV_M_CORE0

BO_ 256 Standard_100_Tx: 8 SDV_M_CORE0
 SG_ Vehicle_Speed : 23|32@0- (1,0) [-3.4E+038|2000] "km/h"  SDV_Tester
 SG_ KL15_Status : 0|1@0+ (1,0) [0|1] ""  SDV_Tester

CM_ SG_ 512 Test_ID_0x200 "test";
BA_DEF_ BO_  "GenMsgSendType" ENUM  "Cycle","cycle","vector_leerstring","Event";
BA_DEF_ BO_  "GenMsgCycleTime" INT 0 65535;
BA_DEF_ BO_  "GenSigSendType" ENUM  "Cycle","cycle","vector_leerstring","Event";
BA_DEF_  "BusType" STRING ;
BA_DEF_DEF_  "GenMsgSendType" "Cycle";
BA_DEF_DEF_  "GenMsgCycleTime" 100;
BA_DEF_DEF_  "GenSigSendType" "Cycle";
BA_DEF_DEF_  "BusType" "CAN";
VAL_ 256 KL15_Status 1 "KL15 ON" 0 "KL15 OFF" ;
SIG_VALTYPE_ 256 Vehicle_Speed : 1;
